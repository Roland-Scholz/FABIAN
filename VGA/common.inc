MEMDUMP2	EQU	9800h
MEMDUMP4	EQU	9802h
MEMDUMP128	EQU	9804h
MEMDUMP512	EQU	9806h
MEMCLR4		EQU	9808h
MEMCLR		EQU	980Ah
MEMFILL		EQU	980Ch
MEMCMP		EQU	980Eh
MEMINTC2	EQU	9810h
MEMINTC4	EQU	9812h
MEMINTC		EQU	9814h
		
INTDIV3		EQU	9816h
INTMUL4		EQU	9818h
INTCMP4		EQU	981Ah
INTCMP		EQU	981Ch
INTCOPY2	EQU	981Eh
INTCOPY4	EQU	9820h
INTCOPY		EQU	9822h
INTSUB2		EQU	9824h
INTSUB4		EQU	9826h
INTSUB		EQU	9828h
INTADD4		EQU	982Ah
INTADD		EQU	982Ch
INTCLR4		EQU	982Eh
INTCLR		EQU	9830h
INTFILL		EQU	9832h

MEMINTA4	EQU	9834h
MEMINTA2	EQU	9836h

INTDUMP6	EQU	9838h
INTDUMP4	EQU	983Ah
INTDUMP2	EQU	983Ch
INTDUMP		EQU	983Eh

ADDDPTR0	EQU	9840h

MEMCOPY		EQU	9842h
MEMDUMP		EQU	9844h
MEMCOPY4	EQU	9846h
PSTRR7		EQU	9848h

STRCOPY		EQU	984Ah
